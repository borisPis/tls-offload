## drivers/net/ethernet/mellanox/accelerator/tls/Kconfig
```kconfig
#
# Mellanox tls accelerator driver configuration
#

config MLX_ACCEL_TLS
	tristate "Mellanox Technologies TLS accelarator driver"
	depends on MLX_ACCEL_CORE && NET_TLS_OFFLOAD
	default n
	---help---
	  TLS accelarator driver by Mellanox Technologies.
```
